## pkg/boot/fit/testdata/fitimage.its
```
/dts-v1/;  // dummy fitimage its file. Replace ${tmp_dir} with proper path
/ {
    description = "U-Boot fitImage for nerf kernel";
    #address-cells = <1>;

    images {
        kernel@0 {
            description = "Signed Linux Kernel";
            data = /incbin/("./dummy_kernel_0");
            type = "kernel";
            arch = "x86_64";
            os = "linux";
            compression = "none";
            load = <0x10000>;
            entry = <0x10000>;
            hash@1 {
                algo = "sha1";
            };
            signature@1 {
                signer-name = "uroot";
                key-name-hint = "key0";
                algo = "pgp";
                value = /incbin/("./key0_kernel0_pgp.sig");
            };
        };
        kernel@1 {
            description = "Unsigned Linux Kernel";
            data = /incbin/("./dummy_kernel_1");
            type = "kernel";
            arch = "x86_64";
            os = "linux";
            compression = "none";
            load = <0x10000>;
            entry = <0x10000>;
            hash@1 {
                algo = "sha1";
            };
        };
        ramdisk@0 {
            description = "signed initramfs";
            data = /incbin/("./dummy_initramfs_0.cpio");
            type = "ramdisk";
            arch = "x86_64";
            os = "linux";
            load = <0x320000>;
            compression = "none";
            hash@1 {
                algo = "sha1";
            };
            signature@0 {
                signer-name = "uroot";
                key-name-hint = "key1";
                algo = "pgp";
                value = /incbin/("./key1_initram0_pgp.sig");
            };
            signature@1 {
                signer-name = "uroot";
                key-name-hint = "key0";
                algo = "pgp";
                value = /incbin/("./key0_initram0_pgp.sig");
            };
        };
    };
    configurations {
        default = "conf@1";
        conf@1 {
            description = "Boot Linux kernel with ramdisk";
            kernel = "kernel@0";
            ramdisk = "ramdisk@0";
            hash@1 {
                algo = "sha1";
            };
        };
        conf_bz@1 {
            description = "Boot Linux kernel with ramdisk";
            kernel = "kernel@0";
            ramdisk = "ramdisk@0";
            hash@1 {
                algo = "sha1";
            };
        };
    };
};
```
